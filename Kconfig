## Kconfig
```kconfig
# Kconfig for ZMK IMU Input Device

DT_COMPAT_ZMK_BEHAVIOR_IMU_INPUT := zmk,behavior-imu-input

menuconfig ZMK_BEHAVIOR_IMU_INPUT
    bool "ZMK IMU input pupport"
    default $(dt_compat_enabled,$(DT_COMPAT_ZMK_BEHAVIOR_IMU_INPUT))
    help
      Enable support for using an Inertial Measurement Unit (IMU)
      as a pointing device in ZMK. This allows for mouse-like
      movement based on IMU sensor data.

if ZMK_BEHAVIOR_IMU_INPUT
    config ZMK_BEHAVIOR_IMU_INPUT_INIT_PRIORITY
        int "IMU input driver initialization priority"
        default INPUT_INIT_PRIORITY
        range 0 99
        help
            Sets the initialization priority for the IMU input behavior.
            Higher numbers mean lower priority (initialized later).
            Sensors typically initialize around 60-70.
            Refer to Zephyr's documentation on initialization priorities
            for more details.
    config ZMK_BEHAVIOR_IMU_INPUT_CALIBRATION_PERIOD
        int "IMU input driver calibration period"
        default 15
        range 0 255
        help
            Sets the calibration period (in cycles) for the imu sensor.
            For example, a value of 20 will average the first 20 values
            and negate them from any continued sensor values.

    config ZMK_BEHAVIOR_IMU_INPUT_DATA_RATE
        int "IMU input driver polling rate"
        default 20
        range 1 1000
        help
            Sets the polling rate on the driver to N reads per second (in hertz).
endif
```

## boards/shields/grippy60/Kconfig.defconfig
```kconfig
if SHIELD_GRIPPY60_LEFT

    # Name must be less than 16 characters long!
    config ZMK_KEYBOARD_NAME
        default "Grippy 60 Left"

    # config ZMK_SPLIT_ROLE_CENTRAL
    #     default y

    # config ZMK_USB
    #     default y

    endif

if SHIELD_GRIPPY60_RIGHT

    # Name must be less than 16 characters long!
    config ZMK_KEYBOARD_NAME
        default "Grippy 60 Right"

    endif

if SHIELD_GRIPPY60_LEFT || SHIELD_GRIPPY60_RIGHT

    config ZMK_BLE
        default y

    # config ZMK_SPLIT
    #     default y

    config ZMK_USB
        default y

    endif

if ZMK_DISPLAY

    config I2C
        default y

    config SSD1306
        default y

    endif # ZMK_DISPLAY

if LVGL

    config LV_Z_VDB_SIZE
        default 64

    config LV_DPI_DEF
        default 148

    config LV_Z_BITS_PER_PIXEL
        default 1

    choice LV_COLOR_DEPTH
        default LV_COLOR_DEPTH_1
    endchoice

    endif # LVGL

if ZMK_POINTING

    config I2C
        default y

    endif # ZMK_POINTING
```

## boards/shields/grippy60/Kconfig.shield
```kconfig
config SHIELD_GRIPPY60_LEFT
    def_bool $(shields_list_contains,grippy60_left)

    config ZMK_COMBO_MAX_PRESSED_COMBOS
        default 4

    config ZMK_COMBO_MAX_COMBOS_PER_KEY
        default 100

    config MAIN_STACK_SIZE
        default 4096

    config INPUT_THREAD_STACK_SIZE
        default 4096

    config SYSTEM_WORKQUEUE_STACK_SIZE
        default 4096

config SHIELD_GRIPPY60_RIGHT
    def_bool $(shields_list_contains,grippy60_right)

    config ZMK_COMBO_MAX_PRESSED_COMBOS
        default 4

    config ZMK_COMBO_MAX_COMBOS_PER_KEY
        default 100

    config MAIN_STACK_SIZE
        default 4096

    config INPUT_THREAD_STACK_SIZE
        default 4096

    config SYSTEM_WORKQUEUE_STACK_SIZE
        default 4096
```

## dts/bindings/behaviors/zmk,behavior-imu-input.yaml
```yaml
# Copyright (c) 2025 The ZMK Contributors
# SPDX-License-Identifier: MIT

description: IMU Mouse behavior

compatible: "zmk,behavior-imu-input"

include: base.yaml

properties:
  sensor:
    type: phandle
    required: true
    description: |
      The device handle for the configured IMU sensor.

  axis-x:
    type: int
    required: true
    description: |
      Configures the X sensor channel.
      Example:
      #include <zmk-imu-mouse/config.h>
      ...
      axis-x: <IMU_AXIS_X>;
  axis-y:
    type: int
    required: true
    description: |
      Configures the Y sensor channel.
      Example:
      #include <zmk-imu-mouse/config.h>
      ...
      axis-y: <IMU_AXIS_Y | IMU_INVERT>;
```

## dts/bindings/behaviors/zmk,behavior-imu-mouse.yaml
```yaml
# Copyright (c) 2025 The ZMK Contributors
# SPDX-License-Identifier: MIT

description: IMU Mouse behavior

compatible: "zmk,behavior-imu-mouse"

include: zero_param.yaml

properties:
  sensor:
    type: phandle
    required: true
    description: |
      The device handle for the configured IMU sensor.

  sensor-axis:
    type: array
    required: true
    description: |
      Configures the X and Y sensor channels for mouse cursor control.
      Example:
      #include <zmk-imu-mouse/config.h>
      ...
      sensor-axis: <IMU_AXIS_X (IMU_AXIS_Y | IMU_INVERT)>;

  perform-scrolling:
    type: boolean
    description: |
      Configures whether the behavior controls movement or scrolling.

  scale-multiplier:
    type: int
    required: false
    default: 1
    description: |
      The scale factor multiplier for sensitivity
  scale-divisor:
    type: int
    required: false
    default: 1
    description: |
      The scale factor divisor.
```
