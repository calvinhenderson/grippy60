#include "grippy60.h"

// {{{ Macros

#define COMBO(NAME, BINDINGS, KEYPOS) \
  combo_##NAME {                      \
    timeout-ms = <COMBO_TIMEOUT>;     \
    bindings = <BINDINGS>;            \
    key-positions = <KEYPOS>;         \
    layers = <COMBO_LAYERS>;          \
  };
#define BCOMBO(NAME, BINDINGS, LEFT_KEYPOS, RIGHT_KEYPOS) \
  combo_l_##NAME {                    \
    timeout-ms = <COMBO_TIMEOUT>;     \
    bindings = <BINDINGS>;            \
    key-positions = <LEFT_KEYPOS>;    \
    layers = <COMBO_LAYERS>;          \
  };                                  \
  combo_r_##NAME {                    \
    timeout-ms = <COMBO_TIMEOUT>;     \
    bindings = <BINDINGS>;            \
    key-positions = <RIGHT_KEYPOS>;   \
    layers = <COMBO_LAYERS>;          \
  };

#define WITH_MOD(MOD_NAME, NAME, BINDINGS, MOD_BINDINGS, L_MOD_KEY, LEFT_KEYPOS, R_MOD_KEY, RIGHT_KEYPOS) \
  COMBO(l_##NAME, BINDINGS, LEFT_KEYPOS) \
  COMBO(r_##NAME, BINDINGS, RIGHT_KEYPOS) \
  COMBO(l_##MOD_NAME, MOD_BINDINGS, L_MOD_KEY LEFT_KEYPOS) \
  COMBO(r_##MOD_NAME, MOD_BINDINGS, R_MOD_KEY RIGHT_KEYPOS)

// }}}
// {{{ Configuration

#define HYPER LC(LA(LGUI))

#define L_BSPC_KEY  L_IT_F
#define R_BSPC_KEY  R_IT_F
                       
#define L_SHIFT_KEY L_IT_B
#define R_SHIFT_KEY R_IT_B
                       
#define L_SYM_KEY   L_IT_F
#define R_SYM_KEY   R_IT_F
                       
#define L_FN_KEY    L_IT_L
#define R_FN_KEY    R_IT_R

// }}}
// {{{ Layers

#undef COMBO_LAYERS
#define COMBO_LAYERS BASE_LAYERS

BCOMBO(FN,        &mo FN,        L_IT_D,      R_IT_D)
BCOMBO(NAV_SPACE, &lt NAV SPACE, L_SHIFT_KEY, R_SHIFT_KEY)

// }}}
// {{{ System

#undef COMBO_LAYERS
#define COMBO_LAYERS BASE_LAYERS

// Hardware
BCOMBO(RESET,  &sys_reset,  L_OT_F L_IT_F,  R_IT_F R_OT_F)
BCOMBO(BOOT,   &bootloader, L_OT_D L_IT_D, R_IT_D R_OT_D)

#undef COMBO_LAYERS
#define COMBO_LAYERS FN

// Set base system layer
BCOMBO(TO_MACOS, &layer_on  MACOS, L_PF_F, R_PF_F)
BCOMBO(TO_LINUX, &layer_off MACOS, L_PF_B, R_PF_B)

// Bluetooth profiles
BCOMBO(BT0,    &bt BT_SEL 0, L_RF_B L_IF_B, R_IF_B R_RF_B)
BCOMBO(BT1,    &bt BT_SEL 1, L_RF_B L_MF_B, R_MF_B R_RF_B)
BCOMBO(BT2,    &bt BT_SEL 2, L_PF_B L_MF_B, R_MF_B R_PF_B)
BCOMBO(BT3,    &bt BT_SEL 3, L_PF_B L_RF_B, R_RF_B R_PF_B)
BCOMBO(BT_CLR, &bt BT_CLR,   L_MF_B L_IF_B, R_IF_B R_MF_B)

// }}}
// {{{ Mods

#undef COMBO_LAYERS
#define COMBO_LAYERS BASE_LAYERS

BCOMBO(BSPC,   &kp BSPC, L_BSPC_KEY, R_BSPC_KEY)

BCOMBO(HYPER,  &kp HYPER, L_OT_L,     R_OT_R)
BCOMBO(LSHFT,  &kp LSHFT, L_PF_D,     R_PF_D)
BCOMBO(LALT,   &kp LALT,  L_RF_D,     R_RF_D)
BCOMBO(LCTRL,  &kp LCTRL, L_MF_D,     R_MF_D)
BCOMBO(LGUI,   &kp LGUI,  L_IF_D,     R_IF_D)

BCOMBO(TAB,    &kp TAB,                L_RF_F L_MF_F L_IF_F,             R_IF_F R_MF_F R_RF_F)
BCOMBO(DEL,    &kp DEL,    L_SHIFT_KEY L_RF_F L_MF_F L_IF_F, R_SHIFT_KEY R_IF_F R_MF_F R_RF_F)

BCOMBO(ENTER,  &kp ENTER,              L_RF_B L_MF_B L_IF_B,             R_IF_B R_MF_B R_RF_B)
BCOMBO(ESC,    &kp ESC,    L_SHIFT_KEY L_RF_B L_MF_B L_IF_B, R_SHIFT_KEY R_IF_B R_MF_B R_RF_B)

// }}}
// {{{ Alphas

#undef COMBO_LAYERS
#define COMBO_LAYERS BASE_LAYERS

WITH_MOD(S_R, R, &kp R, &kp LS(R), L_SHIFT_KEY, L_PF_F,        R_SHIFT_KEY, R_PF_F)
WITH_MOD(S_S, S, &kp S, &kp LS(S), L_SHIFT_KEY, L_RF_F,        R_SHIFT_KEY, R_RF_F)
WITH_MOD(S_N, N, &kp N, &kp LS(N), L_SHIFT_KEY, L_MF_F,        R_SHIFT_KEY, R_MF_F)
WITH_MOD(S_I, I, &kp I, &kp LS(I), L_SHIFT_KEY, L_IF_F,        R_SHIFT_KEY, R_IF_F)
WITH_MOD(S_A, A, &kp A, &kp LS(A), L_SHIFT_KEY, L_PF_B,        R_SHIFT_KEY, R_PF_B)
WITH_MOD(S_O, O, &kp O, &kp LS(O), L_SHIFT_KEY, L_RF_B,        R_SHIFT_KEY, R_RF_B)
WITH_MOD(S_T, T, &kp T, &kp LS(T), L_SHIFT_KEY, L_MF_B,        R_SHIFT_KEY, R_MF_B)
WITH_MOD(S_E, E, &kp E, &kp LS(E), L_SHIFT_KEY, L_IF_B,        R_SHIFT_KEY, R_IF_B)
WITH_MOD(S_B, B, &kp B, &kp LS(B), L_SHIFT_KEY, L_PF_F L_RF_F, R_SHIFT_KEY, R_RF_F R_PF_F)
WITH_MOD(S_Y, Y, &kp Y, &kp LS(Y), L_SHIFT_KEY, L_MF_F L_IF_F, R_SHIFT_KEY, R_IF_F R_MF_F)
WITH_MOD(S_L, L, &kp L, &kp LS(L), L_SHIFT_KEY, L_PF_B L_RF_B, R_SHIFT_KEY, R_RF_B R_PF_B)
WITH_MOD(S_H, H, &kp H, &kp LS(H), L_SHIFT_KEY, L_MF_B L_IF_B, R_SHIFT_KEY, R_IF_B R_MF_B)
WITH_MOD(S_P, P, &kp P, &kp LS(P), L_SHIFT_KEY, L_RF_F L_MF_F, R_SHIFT_KEY, R_MF_F R_RF_F)
WITH_MOD(S_U, U, &kp U, &kp LS(U), L_SHIFT_KEY, L_RF_B L_MF_B, R_SHIFT_KEY, R_MF_B R_RF_B)
WITH_MOD(S_G, G, &kp G, &kp LS(G), L_SHIFT_KEY, L_PF_F L_IF_F, R_SHIFT_KEY, R_IF_F R_PF_F)
WITH_MOD(S_D, D, &kp D, &kp LS(D), L_SHIFT_KEY, L_PF_B L_IF_B, R_SHIFT_KEY, R_IF_B R_PF_B)
WITH_MOD(S_Z, Z, &kp Z, &kp LS(Z), L_SHIFT_KEY, L_PF_F L_MF_F, R_SHIFT_KEY, R_MF_F R_PF_F)
WITH_MOD(S_F, F, &kp F, &kp LS(F), L_SHIFT_KEY, L_RF_F L_IF_F, R_SHIFT_KEY, R_IF_F R_RF_F)
WITH_MOD(S_Q, Q, &kp Q, &kp LS(Q), L_SHIFT_KEY, L_PF_B L_MF_B, R_SHIFT_KEY, R_MF_B R_PF_B)
WITH_MOD(S_C, C, &kp C, &kp LS(C), L_SHIFT_KEY, L_RF_B L_IF_B, R_SHIFT_KEY, R_IF_B R_RF_B)
WITH_MOD(S_X, X, &kp X, &kp LS(X), L_SHIFT_KEY, L_PF_F L_MF_B, R_SHIFT_KEY, R_MF_B R_PF_F)
WITH_MOD(S_K, K, &kp K, &kp LS(K), L_SHIFT_KEY, L_RF_B L_IF_F, R_SHIFT_KEY, R_IF_F R_RF_B)
WITH_MOD(S_V, V, &kp V, &kp LS(V), L_SHIFT_KEY, L_RF_F L_IF_B, R_SHIFT_KEY, R_IF_B R_RF_F)
WITH_MOD(S_J, J, &kp J, &kp LS(J), L_SHIFT_KEY, L_PF_B L_MF_F, R_SHIFT_KEY, R_MF_F R_PF_B)
WITH_MOD(S_M, M, &kp M, &kp LS(M), L_SHIFT_KEY, L_PF_F L_IF_B, R_SHIFT_KEY, R_IF_B R_PF_F)
WITH_MOD(S_W, W, &kp W, &kp LS(W), L_SHIFT_KEY, L_PF_B L_IF_F, R_SHIFT_KEY, R_IF_F R_PF_B)

// }}}
// {{{ Symbols

#undef COMBO_LAYERS
#define COMBO_LAYERS BASE_LAYERS

BCOMBO(LT,     &kp LT,     L_PF_F, R_PF_F)
BCOMBO(RBRC,   &kp RBRC,   L_SYM_KEY L_RF_F, R_SYM_KEY R_RF_F)
BCOMBO(RBKT,   &kp RBKT,   L_SYM_KEY L_MF_F, R_SYM_KEY R_MF_F)
BCOMBO(RPAR,   &kp RPAR,   L_SYM_KEY L_IF_F, R_SYM_KEY R_IF_F)
BCOMBO(GT,     &kp GT,     L_SYM_KEY L_PF_B, R_SYM_KEY R_PF_B)
BCOMBO(LBRC,   &kp LBRC,   L_SYM_KEY L_RF_B, R_SYM_KEY R_RF_B)
BCOMBO(LBKT,   &kp LBKT,   L_SYM_KEY L_MF_B, R_SYM_KEY R_MF_B)
BCOMBO(LPAR,   &kp LPAR,   L_SYM_KEY L_IF_B, R_SYM_KEY R_IF_B)

BCOMBO(FSLH,   &kp FSLH,               L_RF_F L_MF_B,             R_MF_B R_RF_F)
BCOMBO(BSLH,   &kp BSLH,   L_SHIFT_KEY L_RF_F L_MF_B, R_SHIFT_KEY R_MF_B R_RF_F)
BCOMBO(PIPE,   &kp PIPE,   L_SYM_KEY   L_RF_F L_MF_B, R_SYM_KEY   R_MF_B R_RF_F)

BCOMBO(MINUS,  &kp MINUS,              L_RF_B L_MF_F,             R_MF_F R_RF_B)
BCOMBO(UNDER,  &kp UNDER,  L_SHIFT_KEY L_RF_B L_MF_F, R_SHIFT_KEY R_MF_F R_RF_B)
BCOMBO(PRCNT,  &kp PRCNT,  L_SYM_KEY   L_RF_B L_MF_F, R_SYM_KEY   R_MF_F R_RF_B)

BCOMBO(SEMI,   &kp SEMI,               L_PF_F L_RF_B,             R_RF_B R_PF_F)
BCOMBO(COLON,  &kp COLON,  L_SHIFT_KEY L_PF_F L_RF_B, R_SHIFT_KEY R_RF_B R_PF_F)

BCOMBO(QMARK,  &kp QMARK,              L_MF_B L_IF_F,             R_IF_F R_MF_B)
BCOMBO(EXCL,   &kp EXCL,   L_SHIFT_KEY L_MF_B L_IF_F, R_SHIFT_KEY R_IF_F R_MF_B)

BCOMBO(COMMA,  &kp COMMA,              L_MF_F L_IF_B,             R_IF_B R_MF_F)
BCOMBO(DOT,    &kp DOT,    L_SHIFT_KEY L_MF_F L_IF_B, R_SHIFT_KEY R_IF_B R_MF_F)
BCOMBO(TILDE,  &kp TILDE,  L_SYM_KEY   L_MF_F L_IF_B, R_SYM_KEY   R_IF_B R_MF_F)

BCOMBO(SQT,    &kp SQT,                L_PF_B L_RF_F,             R_RF_F R_PF_B)
BCOMBO(DQT,    &kp DQT,    L_SHIFT_KEY L_PF_B L_RF_F, R_SHIFT_KEY R_RF_F R_PF_B)
BCOMBO(GRAVE,  &kp GRAVE,  L_SYM_KEY   L_PF_B L_RF_F, R_SYM_KEY   R_RF_F R_PF_B)

BCOMBO(HASH,   &kp HASH,   L_SYM_KEY L_PF_F L_IF_F, R_SYM_KEY R_IF_F R_PF_F)
BCOMBO(AT,     &kp AT,     L_SYM_KEY L_PF_B L_IF_B, R_SYM_KEY R_IF_B R_PF_B)
BCOMBO(CARET,  &kp CARET,  L_SYM_KEY L_PF_F L_MF_B, R_SYM_KEY R_MF_B R_PF_F)
BCOMBO(PLUS,   &kp PLUS,   L_SYM_KEY L_RF_B L_IF_F, R_SYM_KEY R_IF_F R_RF_B)
BCOMBO(STAR,   &kp STAR,   L_SYM_KEY L_RF_F L_IF_B, R_SYM_KEY R_IF_B R_RF_F)
BCOMBO(EQUAL,  &kp EQUAL,  L_SYM_KEY L_PF_B L_MF_F, R_SYM_KEY R_MF_F R_PF_B)
BCOMBO(DOLLAR, &kp DOLLAR, L_SYM_KEY L_PF_F L_IF_B, R_SYM_KEY R_IF_B R_PF_F)
BCOMBO(AMPS,   &kp AMPS,   L_SYM_KEY L_PF_B L_IF_F, R_SYM_KEY R_IF_F R_PF_B)

// }}}
// {{{ Numbers

#undef COMBO_LAYERS
#define COMBO_LAYERS BASE_LAYERS

BCOMBO(N0,     &kp N0,     L_SYM_KEY L_MF_B L_IF_B, R_SYM_KEY R_IF_B R_MF_B)
BCOMBO(N1,     &kp N1,     L_SYM_KEY L_RF_B L_IF_B, R_SYM_KEY R_IF_B R_RF_B)
BCOMBO(N2,     &kp N2,     L_SYM_KEY L_RF_B L_MF_B, R_SYM_KEY R_MF_B R_RF_B)
BCOMBO(N3,     &kp N3,     L_SYM_KEY L_PF_B L_MF_B, R_SYM_KEY R_MF_B R_PF_B)
BCOMBO(N4,     &kp N4,     L_SYM_KEY L_PF_B L_RF_B, R_SYM_KEY R_RF_B R_PF_B)
BCOMBO(N5,     &kp N5,     L_SYM_KEY L_MF_F L_IF_F, R_SYM_KEY L_IF_F L_MF_F)
BCOMBO(N6,     &kp N6,     L_SYM_KEY L_RF_F L_IF_F, R_SYM_KEY R_IF_F R_RF_F)
BCOMBO(N7,     &kp N7,     L_SYM_KEY L_RF_F L_MF_F, R_SYM_KEY R_MF_F R_RF_F)
BCOMBO(N8,     &kp N8,     L_SYM_KEY L_PF_F L_MF_F, R_SYM_KEY R_MF_F R_PF_F)
BCOMBO(N9,     &kp N9,     L_SYM_KEY L_PF_F L_RF_F, R_SYM_KEY R_RF_F R_PF_F)

// }}}
// {{{ Functions

#undef COMBO_LAYERS
#define COMBO_LAYERS BASE_LAYERS

BCOMBO(F1,     &kp F1,     L_FN_KEY L_RF_B L_IF_B, R_FN_KEY R_IF_B R_RF_B)
BCOMBO(F2,     &kp F2,     L_FN_KEY L_RF_B L_MF_B, R_FN_KEY R_MF_B R_RF_B)
BCOMBO(F3,     &kp F3,     L_FN_KEY L_PF_B L_MF_B, R_FN_KEY R_MF_B R_PF_B)
BCOMBO(F4,     &kp F4,     L_FN_KEY L_PF_B L_RF_B, R_FN_KEY R_RF_B R_PF_B)
BCOMBO(F5,     &kp F5,     L_FN_KEY L_MF_F L_IF_F, R_FN_KEY L_IF_F L_MF_F)
BCOMBO(F6,     &kp F6,     L_FN_KEY L_RF_F L_IF_F, R_FN_KEY R_IF_F R_RF_F)
BCOMBO(F7,     &kp F7,     L_FN_KEY L_RF_F L_MF_F, R_FN_KEY R_MF_F R_RF_F)
BCOMBO(F8,     &kp F8,     L_FN_KEY L_PF_F L_MF_F, R_FN_KEY R_MF_F R_PF_F)
BCOMBO(F9,     &kp F9,     L_FN_KEY L_PF_F L_RF_F, R_FN_KEY R_RF_F R_PF_F)
BCOMBO(F10,    &kp F10,    L_FN_KEY L_MF_B L_IF_B, R_FN_KEY R_IF_B R_MF_B)
BCOMBO(F11,    &kp F11,    L_FN_KEY L_PF_B L_IF_B, R_FN_KEY R_IF_B R_PF_B)
BCOMBO(F12,    &kp F12,    L_FN_KEY L_PF_F L_IF_F, R_FN_KEY R_IF_F R_PF_F)

// }}}
// {{{ Mouse

// Momentary mouse-layer extra actions

#undef COMBO_LAYERS
#define COMBO_LAYERS MOUSE

BCOMBO(MB1, &mkp MB1, L_IF_B, R_IF_B)
BCOMBO(MB2, &mkp MB2, L_MF_B, R_MF_B)
BCOMBO(MB3, &mkp MB3, L_RF_B, R_RF_B)

// }}}
// {{{ Navigation

#undef COMBO_LAYERS
#define COMBO_LAYERS NAV

// Arrows
BCOMBO(left,  &kp LEFT,  L_PF_B, R_IF_B)
BCOMBO(up,    &kp UP,    L_RF_B, R_RF_B)
BCOMBO(down,  &kp DOWN,  L_MF_B, R_MF_B)
BCOMBO(right, &kp RIGHT, L_IF_B, R_PF_B)

// Line/paging
BCOMBO(home, &kp HOME, L_PF_F, R_IF_F)
BCOMBO(pgup, &kp PGUP, L_RF_F, R_RF_F)
BCOMBO(pgdn, &kp PGDN, L_MF_F, R_MF_F)
BCOMBO(end,  &kp END,  L_IF_F, R_PF_F)

// }}}
// {{{ OS-shortcuts

#undef COMBO_LAYERS
#define COMBO_LAYERS LINUX

BCOMBO(L_COPY,  &kp LC(C), L_IF_R, R_IF_L)
BCOMBO(L_CUT,   &kp LC(X), L_IF_L, R_IF_R)
BCOMBO(L_PASTE, &kp LC(V), L_MF_R, R_MF_L)

#undef COMBO_LAYERS
#define COMBO_LAYERS MACOS

BCOMBO(M_COPY,  &kp LG(C), L_IF_R, R_IF_L)
BCOMBO(M_CUT,   &kp LG(X), L_IF_L, R_IF_R)
BCOMBO(M_PASTE, &kp LG(V), L_MF_R, R_MF_L)

// }}}
// {{{ Media

#undef COMBO_LAYERS
#define COMBO_LAYERS FN

// Brightness
BCOMBO(BRIU, &kp C_BRI_UP, L_IF_F, R_IF_F)
BCOMBO(BRID, &kp C_BRI_DN, L_IF_B, R_IF_B)

// Volume control
BCOMBO(VOLU, &kp C_VOL_UP, L_MF_F, R_MF_F)
BCOMBO(MUTE, &kp C_MUTE,   L_MF_D, R_MF_D)
BCOMBO(VOLD, &kp C_VOL_DN, L_MF_B, R_MF_B)

// Playback control
BCOMBO(NEXT, &kp C_NEXT,   L_RF_F, R_RF_F)
BCOMBO(RWND, &kp C_RW,     L_RF_L, R_RF_L)
BCOMBO(PLAY, &kp C_PP,     L_RF_D, R_RF_D)
BCOMBO(FSFW, &kp C_FF,     L_RF_R, R_RF_R)
BCOMBO(PREV, &kp C_PREV,   L_RF_B, R_RF_B)

// }}}
