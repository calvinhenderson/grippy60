
/ {
  chosen {
    zephyr,display = &oled;
  };
};

&i2c0 {
  oled: ssd1306@3c {
    compatible = "solomon,ssd1306fb";
    status = "okay";
    reg = <0x3c>;
    width = <128>;
    height = <32>;
    segment-offset = <0>;
    page-offset = <0>;
    display-offset = <0>;
    multiplex-ratio = <31>;
    com-sequential;
    inversion-on;
    prechargep = <0x22>;
  };
};
